## conf/layer.conf
```bitbake
# We have a conf and classes directory, add to BBPATH
BBPATH .= ":${LAYERDIR}"

# We have recipes-* directories, add to BBFILES
BBFILES += "${LAYERDIR}/recipes-*/*/*.bb \
            ${LAYERDIR}/recipes-*/*/*.bbappend"

BBFILE_COLLECTIONS += "meta-iot-demo"
BBFILE_PATTERN_meta-iot-demo = "^${LAYERDIR}/"
BBFILE_PRIORITY_meta-iot-demo = "6"

LAYERDEPENDS_meta-iot-demo = "core"
LAYERSERIES_COMPAT_meta-iot-demo = "thud"
```
